## config/west.yml
```yaml
manifest:
  remotes:
    - name: zmkfirmware
      url-base: https://github.com/zmkfirmware     
    - name: Garrett Faucher
      url-base: https://github.com/GarrettFaucher
  projects:
    - name: zmk
      remote: zmkfirmware
      revision: main
      import: app/west.yml
    - name: zmk-dongle-display-091-oled
      remote: Garrett Faucher
      revision: main
  self:
    path: config
```
